## sample.yaml
```
sample:
  description: nRF Connect SDK Intermediate Course by Nordic Developer Academy (https://academy.nordicsemi.com/)
  name: nRF Connect SDK Intermediate Course - Lesson 7 Exercise 3 Solution
  
common: 
    sysbuild: true
    integration_platforms: 
      - nrf52dk/nrf52832
      - nrf52833dk/nrf52833
      - nrf52840dk/nrf52840
      - nrf9160dk/nrf9160
      - nrf9160dk/nrf9160/ns
      - nrf9161dk/nrf9161
      - nrf9161dk/nrf9161/ns
      - nrf9151dk/nrf9151
      - nrf9151dk/nrf9151/ns
      - nrf5340dk/nrf5340/cpuapp
      - nrf5340dk/nrf5340/cpuapp/ns
      - nrf54l15dk/nrf54l15/cpuapp
      - nrf54lc10dk/nrf54lc10a/cpuapp
      - nrf54l15dk/nrf54l15/cpuapp/ns
      - nrf54ls05dk/nrf54ls05b/cpuapp
      - nrf54lm20dk/nrf54lm20a/cpuapp
      - nrf7002dk/nrf5340/cpuapp
      - nrf7002dk/nrf5340/cpuapp/ns
    platform_allow:
      - nrf52dk/nrf52832
      - nrf52833dk/nrf52833
      - nrf52840dk/nrf52840
      - nrf9160dk/nrf9160
      - nrf9160dk/nrf9160/ns
      - nrf9161dk/nrf9161
      - nrf9161dk/nrf9161/ns
      - nrf9151dk/nrf9151
      - nrf9151dk/nrf9151/ns
      - nrf5340dk/nrf5340/cpuapp
      - nrf5340dk/nrf5340/cpuapp/ns
      - nrf54l15dk/nrf54l15/cpuapp
      - nrf54lc10dk/nrf54lc10a/cpuapp
      - nrf54l15dk/nrf54l15/cpuapp/ns
      - nrf54ls05dk/nrf54ls05b/cpuapp
      - nrf54lm20dk/nrf54lm20a/cpuapp
      - nrf7002dk/nrf5340/cpuapp
      - nrf7002dk/nrf5340/cpuapp/ns   
    
tests:
  ncs_inter.l7.e3_sol:
    harness: console
    harness_config:
      type: one_line
      regex:
        - "Zephyr Example Application"
    timeout: 15
```

## prj.conf
```kconfig
CONFIG_LOG=y

CONFIG_CBPRINTF_FP_SUPPORT=y
CONFIG_RESET_ON_FATAL_ERROR=n

# STEP 5.2 - Enable Kconfigs 
CONFIG_BLINK=y
```

## boards/nrf9151dk_nrf9151_ns.conf
```kconfig
#UART1 is used for TF-M logging should be disabled
CONFIG_TFM_SECURE_UART=n
CONFIG_TFM_LOG_LEVEL_SILENCE=y

# Minimal TF-M profile required by the no-bootloader partition layout
CONFIG_TFM_PROFILE_TYPE_MINIMAL=y
```

## boards/nrf52833dk_nrf52833.overlay
```dts
/* STEP 5 Create a blink_gpio_leds device node */
/ {
	blink_led: blink-led {
		compatible = "blink-gpio-led";
		led-gpios = <&gpio0 13 GPIO_ACTIVE_LOW>;
		blink-period-ms = <1000>;
	};
};
```

## boards/nrf52dk_nrf52832.overlay
```dts
/* STEP 5 Create a blink_gpio_leds device node */
/ {
	blink_led: blink-led {
		compatible = "blink-gpio-led";
		led-gpios = <&gpio0 17 GPIO_ACTIVE_LOW>;
		blink-period-ms = <1000>;
	};
};
```

## boards/nrf5340dk_nrf5340_cpuapp_ns.overlay
```dts
/* STEP 5 Create a blink_gpio_leds device node */
/ {
	blink_led: blink-led {
		compatible = "blink-gpio-led";
		led-gpios = <&gpio0 28 GPIO_ACTIVE_LOW>;
		blink-period-ms = <1000>;
	};
};
```

## boards/nrf54l15dk_nrf54l15_cpuapp_ns.overlay
```dts
/* STEP 5 Create a blink_gpio_leds device node */
/ {
	blink_led: blink-led {
		compatible = "blink-gpio-led";
		led-gpios = <&gpio2 9 GPIO_ACTIVE_HIGH>;
		blink-period-ms = <1000>;
	};
};
```

## boards/nrf54lc10dk_nrf54lc10a_cpuapp.overlay
```dts
/* STEP 5 Create a blink_gpio_leds device node */
/ {
	blink_led: blink-led {
		compatible = "blink-gpio-led";
		led-gpios = <&gpio1 10 GPIO_ACTIVE_HIGH>;
		blink-period-ms = <1000>;
	};
};
```

## boards/nrf54lm20dk_nrf54lm20a_cpuapp.overlay
```dts
/* STEP 5 Create a blink_gpio_leds device node */
/ {
	blink_led: blink-led {
		compatible = "blink-gpio-led";
		led-gpios = <&gpio1 22 GPIO_ACTIVE_HIGH>;
		blink-period-ms = <1000>;
	};
};
```

## src/main.c
```c
/*
 * Copyright (c) 2021 Nordic Semiconductor ASA
 * SPDX-License-Identifier: Apache-2.0
 */

 #include <zephyr/kernel.h>
 #include <blink.h>
 #include <zephyr/logging/log.h>
LOG_MODULE_REGISTER(Lesson7_Exercise3, LOG_LEVEL_INF);
 
  
 #define BLINK_PERIOD_MS_STEP 100U
 #define BLINK_PERIOD_MS_MAX  1000U
 
 int main(void)
 {
    /* Start blinking - slow*/ 
    unsigned int period_ms = BLINK_PERIOD_MS_MAX;
 
     LOG_INF("Zephyr Example Application");
 
     const struct device * blink = DEVICE_DT_GET(DT_NODELABEL(blink_led));
     if (!device_is_ready(blink)) {
         LOG_ERR("Blink LED not ready");
         return 0;
     }

     /* STEP 5.3 Use the custom blink API from the driver to change the blinking period */
     /* Use custom API  to turn LED  off */
     int ret = blink_off(blink);
     if (ret < 0) {
         LOG_ERR("Could not turn off LED (%d)", ret);
         return 0;
     }
 
     while (1) {
        
        /* When LED is constantly enabled - start over with high blinking period*/
        if (period_ms == 0U) {
            period_ms = BLINK_PERIOD_MS_MAX;
        } else {
            period_ms -= BLINK_PERIOD_MS_STEP;
        }
 
        LOG_INF("Setting LED period to %u ms",
            period_ms);
        
        /* Use custom API to change LED blinking period*/
        blink_set_period_ms(blink, period_ms);
       

        k_sleep(K_MSEC(2000));
     }
 
     return 0;
 }
 
 
```
