## l7/l7_e1_sol/custom_driver_module/drivers/Kconfig
```kconfig
#STEP 6.6: Add the sensor submenu
menu "Drivers"
rsource "sensor/Kconfig"
endmenu
```

## l7/l7_e1_sol/custom_driver_module/drivers/sensor/Kconfig
```kconfig
#STEP 6.4: Add the custom driver as a subdirectory of the sensor driver
if SENSOR
rsource "custom_bme280/Kconfig"
endif
```

## l7/l7_e1_sol/custom_driver_module/drivers/sensor/custom_bme280/Kconfig
```kconfig
#STEP 6.2 Populate the Kconfig file for the custom driver
config CUSTOM_BME280
	bool "Custom BME280 sensor"
	depends on DT_HAS_ZEPHYR_CUSTOM_BME280_ENABLED
	select SPI
	help
	  Enable custom BME280 driver
```

## l7/l7_e2_sol/custom_driver_module/drivers/sensor/custom_bme280/Kconfig
```kconfig
config CUSTOM_BME280
	bool "Custom BME280 sensor"
	depends on DT_HAS_ZEPHYR_CUSTOM_BME280_ENABLED
	select SPI
	help
	  Enable custom BME280 driver
```

## l8/custom_image/sample.yaml
```yaml
sample:
  description: Custom project for nRF Connect SDK Intermediate Course by Nordic Developer Academy (https://academy.nordicsemi.com/)
  name: nRF Connect SDK Intermediate Course (Lesson 8 - Exercise 2 - Custom Image)

common: 
    sysbuild: true
    build_only: true
    integration_platforms: 
      - nrf54l15dk/nrf54l15/cpuflpr
      - nrf54ls05dk/nrf54ls05b/cpuapp
    platform_allow:
      - nrf54l15dk/nrf54l15/cpuflpr    
      - nrf54ls05dk/nrf54ls05b/cpuapp
    
tests:
  ncs_inter.l8.e2.custom_image: {}
```

## l8/l8_e2/sample.yaml
```yaml
sample:
  description: nRF Connect SDK Intermediate Course by Nordic Developer Academy (https://academy.nordicsemi.com/)
  name: nRF Connect SDK Intermediate Course - Lesson 8 Exercise 2

common: 
    sysbuild: true
    build_only: true
    skip: true
    integration_platforms: 
      - nrf5340dk/nrf5340/cpuapp
      - nrf54l15dk/nrf54l15/cpuapp
      - nrf54ls05dk/nrf54ls05b/cpuapp
    platform_allow:
      - nrf5340dk/nrf5340/cpuapp
      - nrf54l15dk/nrf54l15/cpuapp
      - nrf54ls05dk/nrf54ls05b/cpuapp
    
tests:
  ncs_inter.l8.e2: {}
```

## l9/l9_e1/sample.yaml
```yaml
sample:
  description: nRF Connect SDK Intermediate Course by Nordic Developer Academy (https://academy.nordicsemi.com/)
  name: nRF Connect SDK Intermediate Course - Lesson 9 Exercise 1
  
common: 
    sysbuild: true
    build_only: true
    skip: true
    integration_platforms: 
      - nrf52dk/nrf52832
      - nrf52833dk/nrf52833
      - nrf52840dk/nrf52840
      - nrf9160dk/nrf9160/ns
      - nrf9161dk/nrf9161/ns
      - nrf9151dk/nrf9151/ns
      - nrf5340dk/nrf5340/cpuapp
      - nrf5340dk/nrf5340/cpuapp/ns
      - nrf54l15dk/nrf54l15/cpuapp
      - nrf54l15dk/nrf54l15/cpuapp/ns
    platform_exclude:
      - native_sim
    
tests:
  ncs_inter.l9.e1: {}
```

## l9/l9_e3/spi/sample.yaml
```yaml
sample:
  description: nRF Connect SDK Intermediate Course by Nordic Developer Academy (https://academy.nordicsemi.com/)
  name: nRF Connect SDK Intermediate Course - Lesson 9 Exercise 3 SPI


common: 
    sysbuild: true
    build_only: true
    skip: true
    
tests:
  ncs_inter.l9.e3.spi.gd:
    sysbuild: true
    build_only: true
    integration_platforms:
      - nrf9161dk/nrf9161/ns
      - nrf9151dk/nrf9151/ns
    platform_allow:
      - nrf9161dk/nrf9161/ns
      - nrf9151dk/nrf9151/ns      
    
  ncs_inter.l9.e3.spi.mx:
    sysbuild: true
    build_only: true
    integration_platforms:
      - nrf9160dk/nrf9160/ns
      - nrf54l15dk/nrf54l15/cpuapp
      - nrf54l15dk/nrf54l15/cpuapp/ns
      - nrf54lm20dk/nrf54lm20a/cpuapp
      - nrf7002dk/nrf5340/cpuapp
      - nrf7002dk/nrf5340/cpuapp/ns
    platform_allow:
      - nrf9160dk/nrf9160/ns
      - nrf54l15dk/nrf54l15/cpuapp
      - nrf54l15dk/nrf54l15/cpuapp/ns
      - nrf54lm20dk/nrf54lm20a/cpuapp
      - nrf7002dk/nrf5340/cpuapp
      - nrf7002dk/nrf5340/cpuapp/ns      
```

## l9/l9_e3_sol/spi/sample.yaml
```yaml
sample:
  description: nRF Connect SDK Intermediate Course by Nordic Developer Academy (https://academy.nordicsemi.com/)
  name: nRF Connect SDK Intermediate Course - Lesson 9 Exercise 3 SPI Solution

common: 
    sysbuild: true
    build_only: true
    platform_exclude:
      - native_sim
    
tests:
  ncs_inter.l9.e3.spi_sol.gd:
    integration_platforms:
      - nrf9161dk/nrf9161/ns
      - nrf9151dk/nrf9151/ns
    extra_dtc_overlay_files:
      - app_gd.overlay
      - sysbuild/mcuboot_gd.overlay

  ncs_inter.l9.e3.spi_sol.mx:
    integration_platforms:
      - nrf9160dk/nrf9160/ns
      - nrf7002dk/nrf5340/cpuapp
      - nrf7002dk/nrf5340/cpuapp/ns
      - nrf54l15dk/nrf54l15/cpuapp  
      - nrf54l15dk/nrf54l15/cpuapp/ns
    extra_dtc_overlay_files:
      - app_mx.overlay
      - sysbuild/mcuboot_mx.overlay
  
```

## l9/l9_e5_sol/sample.yaml
```yaml
sample:
  description: nRF Connect SDK Intermediate Course by Nordic Developer Academy (https://academy.nordicsemi.com/)
  name: nRF Connect SDK Intermediate Course - Lesson 9 Exercise 5 Solution
  
common: 
    sysbuild: true
    build_only: true
    integration_platforms: 
      - nrf52dk/nrf52832
      - nrf52833dk/nrf52833
      - nrf52840dk/nrf52840
      - nrf5340dk/nrf5340/cpuapp
      - nrf5340dk/nrf5340/cpuapp/ns
      - nrf54l15dk/nrf54l15/cpuapp
      - nrf54l15dk/nrf54l15/cpuapp/ns
      - nrf54lm20dk/nrf54lm20a/cpuapp
    platform_allow:
      - nrf52dk/nrf52832
      - nrf52833dk/nrf52833
      - nrf52840dk/nrf52840
      - nrf5340dk/nrf5340/cpuapp
      - nrf5340dk/nrf5340/cpuapp/ns
      - nrf54l15dk/nrf54l15/cpuapp
      - nrf54l15dk/nrf54l15/cpuapp/ns
      - nrf54lm20dk/nrf54lm20a/cpuapp    
    
tests:
  ncs_inter.l9.e5_sol: {}
```

## l9/v2.5.x/l9_e4/sample.yaml
```yaml
sample:
  description: nRF Connect SDK Intermediate Course by Nordic Developer Academy (https://academy.nordicsemi.com/)
  name: nRF Connect SDK Intermediate Course (Lesson 9 - Exercise 4 - v2.5.x)
```

## l9/v2.5.x/l9_e7/sample.yaml
```yaml
sample:
  description: nRF Connect SDK Intermediate Course by Nordic Developer Academy (https://academy.nordicsemi.com/)
  name: nRF Connect SDK Intermediate Course (Lesson 9 - Exercise 7 - v2.5.x)
```

## lesson3/inter_less3_exer2_solution/boards/arm/devacademy_nrf9161/Kconfig.board
```kconfig
# DevAcademy NRF9161 board configuration

# Copyright (c) 2023 Nordic Semiconductor ASA
# SPDX-License-Identifier: Apache-2.0

if SOC_NRF9161_LACA

config BOARD_DEVACADEMY_NRF9161
	bool "DevAcademy NRF9161"

config BOARD_DEVACADEMY_NRF9161_NS
	bool "DevAcademy NRF9161 non-secure"

endif # SOC_NRF9161_LACA
```

## lesson7/inter_less7_exer1/custom_bme280_driver/dts/bindings/custom,bme280.yaml
```yaml
# Copyright (c) 2023, Nordic Semiconductor
# SPDX-License-Identifier: Apache-2.0

description: BME280 integrated environmental sensor

compatible: "custom,bme280"

include: spi-device.yaml
```

## lesson7/inter_less7_exer1/custom_bme280_driver/zephyr/Kconfig
```kconfig
# BME280 custom driver options 

# Copyright (c) 2019 Nordic Semiconductor
# SPDX-License-Identifier: Apache-2.0

menuconfig CUSTOM_BME280_DRIVER
	bool "Support for the demonstration out of tree custom BME280 driver using SPI"
	depends on SPI


if CUSTOM_BME280_DRIVER

source "subsys/logging/Kconfig.template.log_config"
# STEP 3 - Add a custom driver initialization priority

endif
```

## v2.6.2-v2.5.2/l3/l3_e1_sol/boards/arm/devacademy_nrf52833/Kconfig.board
```kconfig
# Copyright (c) 2023 Nordic Semiconductor ASA
# SPDX-License-Identifier: Apache-2.0

config BOARD_DEVACADEMY_NRF52833
	bool "DevAcademy nRF52833"
	depends on SOC_NRF52833_QIAA
```

## v2.6.2-v2.5.2/l3/l3_e1_sol/boards/arm/devacademy_nrf52833/Kconfig.defconfig
```kconfig
# Copyright (c) 2023 Nordic Semiconductor ASA
# SPDX-License-Identifier: Apache-2.0

if BOARD_DEVACADEMY_NRF52833

config BOARD
	default "devacademy_nrf52833"

config BT_CTLR
   default BT

endif
```

## v2.6.2-v2.5.2/l8/l8_e2_sol/boards/nrf5340dk_nrf5340_cpuapp_ns.conf
```kconfig
# For TF-M, MCUboot gets limited RAM. 
# However, for nRF5340 netcore update, it needs a lot of RAM.
# See Kconfig description for a security warning
CONFIG_MCUBOOT_USE_ALL_AVAILABLE_RAM=y
```

## v2.8.x-v2.7.0/l3/l3_e1_sol/boards/nordic/devacademyl3e1/devacademyl3e1_defconfig
```kconfig
CONFIG_ARM_MPU=y
CONFIG_HW_STACK_PROTECTION=y

# Enable RTT
CONFIG_USE_SEGGER_RTT=y

# enable GPIO
CONFIG_GPIO=y

# enable uart driver
CONFIG_SERIAL=y

# enable console
CONFIG_CONSOLE=y
CONFIG_UART_CONSOLE=y
```

## v2.8.x-v2.7.0/l3/l3_e2_sol/boards/nordic/devacademyl3e2/Kconfig.devacademyl3e2
```kconfig
# DevAcademyL3E2 NRF9151 board configuration

# Copyright (c) 2023 Nordic Semiconductor ASA
# SPDX-License-Identifier: Apache-2.0

config BOARD_DEVACADEMYL3E2
	select SOC_NRF9151_LACA
```
