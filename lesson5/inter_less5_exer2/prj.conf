## CMakeLists.txt
```
cmake_minimum_required(VERSION 3.20.0)
find_package(Zephyr REQUIRED HINTS $ENV{ZEPHYR_BASE})

project(inter_less5_exer2)

target_sources(app PRIVATE src/main.c)
```

## sample.yaml
```
sample:
  description: nRF Connect SDK Intermediate Course by Nordic Developer Academy (https://academy.nordicsemi.com/)
  name: nRF Connect SDK Intermediate Course (Lesson 5 - Exercise 2)
```

## prj.conf
```kconfig
# Step 2 - Enable nrfx SAADC driver #
```

## src/main.c
```c
/*
 * Copyright (c) 2024 Nordic Semiconductor ASA
 *
 * SPDX-License-Identifier: Apache-2.0
 */

#include <zephyr/logging/log.h>
#include <zephyr/kernel.h>
#include <zephyr/device.h>
#include <zephyr/devicetree.h>
#include <zephyr/drivers/display.h>

/* STEP 7 - Include the header file for the ili_screen_controller module*/


LOG_MODULE_REGISTER(Lesson4_Exercise2, LOG_LEVEL_INF);

#define BKGCOLOR 	0x00U		// Greyscale value for background
#define HLINECOLOR	0xFF0000	// RGB value for line-color (0xRRGGBB)
#define DLINECOLOR  0x0000FF	// RGB value for pixelated diagonal line (0xRRGGBB)
#define BOXCOLOR	0xFFFF00	// RGB value for box-color (0xRRGGBB)
#define DELAY		20			// Delay in ms for visual effect

int set_background_color(const struct device *screen, struct display_capabilities cap)
{
	uint8_t *buf;
	size_t buf_size;  
	uint16_t h_step = 1;
	int err;
	struct display_buffer_descriptor buf_desc;
	
	/* Set buffer size for one row and allocate buffer (1 pixel = 3 bytes) */
	buf_size = cap.x_resolution;
	buf_size *= 3;
	buf = k_malloc(buf_size);
	if (buf == NULL) {
		LOG_ERR("set_background_color: Memory allocation error");
		return -1;
	}

	/* Fill the buffer with greyscale and set buffer descriptor */
	(void)memset(buf, BKGCOLOR, buf_size);
	buf_desc.buf_size = buf_size;
	buf_desc.width = cap.x_resolution;	
	buf_desc.height = h_step;
	buf_desc.pitch = cap.x_resolution;
	
	/* STEP 8 - Write background values to screen (row by row) and free buffer */
	
	return 0;
}

int draw_diagonal_line(const struct device *screen, uint8_t x, uint8_t y, uint8_t nump)
{
	uint8_t *buf;
	uint8_t buf_size = 1;
	int err;
	struct display_buffer_descriptor buf_desc;
	buf_size *= 3;

	/* Set buffer and descriptor for a single pixel */
	buf = k_malloc(buf_size);
	if (buf == NULL) {
		LOG_ERR("draw_diagonal_line: Memory allocation error");
		return -1;
	}

	buf_desc.buf_size = buf_size;
	buf_desc.width = buf_size;
	buf_desc.height = 1;
	buf_desc.pitch = buf_size;

	/* Fill the color buffer */
	fill_buf_24bit(DLINECOLOR, buf, buf_size);

	LOG_INF("Displaying diagonal line, starting pixel (x, y) = %2d, %2d", x, y);
	/* STEP 9 - Display a diagonal line given a starting location (x,y) */
	
	k_free(buf);
	LOG_INF("Last pixel (x, y)= %2d, %2d", x, y);
	return 0;
}

int draw_lines(const struct device *screen, uint8_t x, uint8_t y, uint8_t dy, uint8_t w, uint8_t numl)
{
	uint8_t *buf;
	size_t buf_size;
	int err;
	struct display_buffer_descriptor buf_desc;

	buf_size = w;
	buf_size *= 3;
	
	/* Set buffer and descriptor for a single line */		
	buf = k_malloc(buf_size);
	if (buf == NULL) {
		LOG_ERR("draw_lines: Memory allocation error");
		return -1;
	}
	buf_desc.buf_size = buf_size;
	buf_desc.width = buf_size;
	buf_desc.height = 1;
	buf_desc.pitch = buf_size;
		
	/* Fill the color buffer */
	fill_buf_24bit(HLINECOLOR, buf, buf_size);	
	
	LOG_INF("Displaying series of lines (1 line at a time), starting line (x, y) = %2d, %2d", x, y);
	/* STEP 10 - Display multiple straight lines with screen_write() */
	
	k_free(buf);
	LOG_INF("Last line (x, y)= %2d, %2d", x, y);
	return 0;
}


int draw_box(const struct device *screen, uint8_t x, uint8_t y, uint8_t w, uint8_t h )
{
	uint8_t *buf;
	size_t buf_size;
	int err;
	struct display_buffer_descriptor buf_desc;

	/* Set buffer and descriptor for rectangular box */
	buf_size = w * h;
	buf_size *= 3;
	buf = k_malloc(buf_size);
	if (buf == NULL) {
		LOG_ERR("draw_box: Memory allocation Error");
		return -1;
	}
	buf_desc.buf_size = buf_size;
	buf_desc.width = w;
	buf_desc.height = h;
	buf_desc.pitch = w;
	
	/* Fill the color buffer */
	fill_buf_24bit(BOXCOLOR, buf, buf_size);

	LOG_INF("Displaying a rectangular box, top left corner (x,y) = %2d, %2d", x, y);
	/* STEP 11 - Draw a  rectangular box, given the top left hand corner (x,y) */
	

	k_free(buf);
	LOG_INF("Bottom right corner (x, y) of box = %2d, %2d", x+w, y+h);
	display_blanking_off(screen);

	return 0;
}

int main(void)
{
	int err;

	/* Initialize variables to suitable values (as per screen size) */
	size_t x = 0, y = 0, dy = 0;						
	size_t w = 80, h = 40;								
	const struct device *screen;						
	struct display_capabilities cap;					
	uint8_t num_pixels = 100;	
	uint8_t num_lines = 25;																				

	/* STEP 12 - Obtain the screen node from device tree */
	

	/* Setting orientation 1 (W=320 H=240) */
	err = display_set_orientation(screen, 1);
	if (err < 0) {
		LOG_ERR("Error %d",err);
		return 0;
	}
	
	/* Setting pixel format 1 (24 bit) */
	err = display_set_pixel_format(screen, 1);
	if (err < 0) {
		LOG_ERR("Error %d",err);
		return 0;
	}

	/* Obtain and display screen capabilities */
	display_get_capabilities(screen, &cap);

	LOG_INF("Display Sample on %s: Orientation=%d,  Pixel-format=%d,   X-res=%d,   Y-res=%d", \
							screen->name, cap.current_orientation, cap.current_pixel_format,  \
							cap.x_resolution, cap.y_resolution);

	/* STEP 13 - Observe that we call the previously define functions one-by-one */
	/* Set the background color */
	err = set_background_color(screen, cap);
	if (err < 0) {
		LOG_ERR("Error %d",err);
		return 0;
	}

	/* Display a diagonal line (pixel by pixel) */
	x = 20;
	y = 20;
	err = draw_diagonal_line(screen, x, y, num_pixels);
	if (err < 0) {
		LOG_ERR("Error %d",err);
		return 0;
	}
	
	/* Display a series of lines (1 line at a time) */
	x = 100; 
	y = 100;
	dy = 3;	
	err = draw_lines(screen, x, y, dy, w, num_lines);
	if (err < 0) {
		LOG_ERR("Error %d",err);
		return 0;
	}

	/* Display a rectangular box */
	x = 30; 
	y = 130;
	err = draw_box(screen, x, y, w, h);
	if (err < 0) {
		LOG_ERR("Error %d",err);
		return 0;
	}

	return 0;
}
```

## src/ili_screen_controller.c
```c
/*
 * Copyright (c) 2024 Nordic Semiconductor ASA
 *
 * SPDX-License-Identifier: Apache-2.0
 */

#include <zephyr/kernel.h>
#include <zephyr/logging/log.h>

/* STEP 3.1 - Include the header files for SPI, GPIO and devicetree */
#include <zephyr/device.h>
#include <zephyr/devicetree.h>
#include <zephyr/drivers/gpio.h>
#include <zephyr/drivers/spi.h>

/* STEP 3.2 - Include display driver and custom header files */


LOG_MODULE_DECLARE(Lesson4_Exercise2, LOG_LEVEL_INF);

/* Structure for ILI9340 controller configuration*/
enum madctl_cmd_set {CMD_SET_1,	CMD_SET_2,};
struct ili9xxx_quirks {enum madctl_cmd_set cmd_set;};
struct ili_ctrl_config {
	const struct ili9xxx_quirks *quirks;
	struct spi_dt_spec spi;
	struct gpio_dt_spec cmd_data;
	struct gpio_dt_spec reset;
	uint8_t pixel_format;
	uint16_t rotation;
	uint16_t x_resolution;
	uint16_t y_resolution;
	bool inversion;
	const void *regs;
	int (*regs_init_fn)(const struct device *dev);
};

/* Structure for ILI9340 controller data*/
struct ili_ctrl_data {
	uint8_t bytes_per_pixel;
	enum display_pixel_format pixel_format;
	enum display_orientation orientation;
};

/* Function to fill buffer with RBG color */
void fill_buf_24bit(uint32_t color, uint8_t *buf, size_t buf_size)
{
	for (size_t idx = 0; idx < buf_size; idx += 3) {
		*(buf + idx + 0) = color >> 16;
		*(buf + idx + 1) = color >> 8;
		*(buf + idx + 2) = color >> 0;
	}
}

/* Function for Screen SPI Controller to transmit the command and data
 * It takes device pointer, 1-byte command, data pointer and length
 * The function calls underlying GPIO and SPI functions to transfer */
int spi_ctrl_transmit(const struct device *dev, uint8_t cmd, const void *tx_data, size_t tx_len)
{
	int err;
	const struct ili_ctrl_config *config = dev->config;
	
	/* STEP 4.1 - Declare and configure the transmit buffers with command parameters */
	

	/* STEP 4.2 - Set GPIO pin for Command and write using spi_write_dt() */
	

	/* STEP 4.3 - Transmit the data that follows the command, if any. */
	

	return 0;
}

/* Function to set ili controller memory area
 * It takes device pointer, (x,y) coordinates, and (w,h) area parameters
 * w=width h=height x_start=x, x_end=x+w-1, y_end=y+h-1
 * The function calls spi_ctrl_transmit() to transmit command & data */
int ili_ctrl_setmem(const struct device *dev, const uint16_t x, const uint16_t y, \
						   const uint16_t w, const uint16_t h)
{
	int err;
	uint16_t spi_xdata[2];
	uint16_t spi_ydata[2];

	/* Set and transmit column and row starting and ending address */
	spi_xdata[0] = sys_cpu_to_be16(x);
	spi_xdata[1] = sys_cpu_to_be16(x + w - 1U);
	spi_ydata[0] = sys_cpu_to_be16(y);
	spi_ydata[1] = sys_cpu_to_be16(y + h - 1U);

	/* STEP 5 - Call spi_ctrl_transmit() to transmit CASET and PASET commands */
	

	return 0;
}

/* Function to write to the screen
 * It takes device pointer, (x,y) starting coordinates, descriptor and buffer
 * It calls ili_ctrl_setmem() to set the active area
 * And then writes buffer into active area memory using spi_ctrl_transmit() */
int screen_write(const struct device *dev, const uint16_t x, const uint16_t y, \
			 const struct display_buffer_descriptor *desc, const void *buf)
{
	int err;
	const uint8_t *data_start_addr = (const uint8_t *)buf;

	const struct ili_ctrl_config *config = dev->config;
	struct ili_ctrl_data *data = dev->data;

	struct spi_buf tx_buf;
	struct spi_buf_set tx_bufs;

	uint16_t write_cnt;
	uint16_t nbr_of_writes;
	uint16_t write_h;

	err = ili_ctrl_setmem(dev, x, y, desc->width, desc->height);
	if (err < 0) {
		return err;
	}

	if (desc->pitch > desc->width) {write_h = 1U; nbr_of_writes = desc->height;}
	else {write_h = desc->height; nbr_of_writes = 1U;}

	/* STEP 6 - Call spi_ctrl_transmit() to send the RAMWR command */
	

	tx_bufs.buffers = &tx_buf;
	tx_bufs.count = 1;

	data_start_addr += desc->pitch * data->bytes_per_pixel;
	for (write_cnt = 1U; write_cnt < nbr_of_writes; ++write_cnt) {
		tx_buf.buf = (void *)data_start_addr;
		tx_buf.len = desc->width * data->bytes_per_pixel * write_h;

		err = spi_write_dt(&config->spi, &tx_bufs);
		if (err < 0) {
			return err;
		}

		data_start_addr += desc->pitch * data->bytes_per_pixel;
	}

	return 0;
}
```
