## l8/l8_e2_sol/sample.yaml
```yaml
sample:
  description: nRF Connect SDK Intermediate Course by Nordic Developer Academy (https://academy.nordicsemi.com/)
  name: nRF Connect SDK Intermediate Course - Lesson 8 Exercise 2 Solution

common: 
    sysbuild: true
    integration_platforms: 
      - nrf5340dk/nrf5340/cpuapp
      - nrf54l15dk/nrf54l15/cpuapp
      - nrf54lc10dk/nrf54lc10a/cpuapp

    platform_allow:
      - nrf5340dk/nrf5340/cpuapp
      - nrf54l15dk/nrf54l15/cpuapp    
      - nrf54lc10dk/nrf54lc10a/cpuapp

    
tests:
  ncs_inter.l8.e2_sol:
    harness: console
    harness_config:
      type: one_line
      regex:
        - "Hello from DevAcademy Intermediate, Lesson 8, Exercise 2"
    timeout: 15
```

## l9/l9_e5_nrf5340_both_sol/sample.yaml
```yaml
sample:
  description: nRF Connect SDK Intermediate Course by Nordic Developer Academy (https://academy.nordicsemi.com/)
  name: nRF Connect SDK Intermediate Course - Lesson 9 Exercise 5 Solution - OPTIONAL nRF5340 Both Cores
  
common: 
    sysbuild: true
    harness: console
    harness_config:
      type: one_line
      regex:
        - "Starting Bluetooth Peripheral LBS sample"
    integration_platforms: 
      - nrf5340dk/nrf5340/cpuapp
    platform_allow:
      - nrf5340dk/nrf5340/cpuapp
    
tests:
  ncs_inter.l9.e5.nrf53_sol: {}
```

## l9/l9_e5_sol/sysbuild/mcuboot/boards/nrf54lm20dk_nrf54lm20a_cpuapp.conf
```kconfig
CONFIG_BOOT_MAX_IMG_SECTORS_AUTO=n
CONFIG_BOOT_MAX_IMG_SECTORS=256


# from mcuboot/boot/zephyr/boards
CONFIG_SPI_NOR=n
CONFIG_BOOT_WATCHDOG_FEED=n
```
