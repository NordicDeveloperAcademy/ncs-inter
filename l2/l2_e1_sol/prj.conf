## sample.yaml
```
sample:
  description: nRF Connect SDK Intermediate Course by Nordic Developer Academy (https://academy.nordicsemi.com/)
  name: nRF Connect SDK Intermediate Course - Lesson 2 Exercise 1 Solution
  
common: 
    sysbuild: true
    integration_platforms: 
      - nrf52dk/nrf52832
      - nrf52833dk/nrf52833
      - nrf52840dk/nrf52840
      - nrf9160dk/nrf9160
      - nrf9161dk/nrf9161
      - nrf9151dk/nrf9151
      - nrf5340dk/nrf5340/cpuapp
      - nrf54l15dk/nrf54l15/cpuapp
      - nrf54lc10dk/nrf54lc10a/cpuapp
      - nrf54l15dk/nrf54l15/cpuapp/ns
      - nrf54ls05dk/nrf54ls05b/cpuapp
      - nrf54lm20dk/nrf54lm20a/cpuapp
      - nrf7002dk/nrf5340/cpuapp
    platform_allow:
      - nrf52dk/nrf52832
      - nrf52833dk/nrf52833
      - nrf52840dk/nrf52840
      - nrf9160dk/nrf9160
      - nrf9161dk/nrf9161
      - nrf9151dk/nrf9151
      - nrf5340dk/nrf5340/cpuapp
      - nrf54l15dk/nrf54l15/cpuapp
      - nrf54lc10dk/nrf54lc10a/cpuapp
      - nrf54l15dk/nrf54l15/cpuapp/ns
      - nrf54ls05dk/nrf54ls05b/cpuapp
      - nrf54lm20dk/nrf54lm20a/cpuapp
      - nrf7002dk/nrf5340/cpuapp
    
tests:
  ncs_inter.l2.e1_sol:
    harness: console
    harness_config:
      type: one_line
      regex:
        - "Starting Exercise 1!"
    timeout: 15
```

## prj.conf
```kconfig
#
# Copyright (c) 2024 Nordic Semiconductor
#
# SPDX-License-Identifier: LicenseRef-Nordic-5-Clause
#

CONFIG_LOG=y
```

## src/main.c
```c
/*
 * Copyright (c) 2024 Nordic Semiconductor ASA
 *
 * SPDX-License-Identifier: LicenseRef-Nordic-5-Clause
 */

#include <stdio.h>
#include <zephyr/kernel.h>
#include <zephyr/logging/log.h>

LOG_MODULE_REGISTER(Lesson2_Exercise1, LOG_LEVEL_INF);
int8_t test_var = 124;

int main(void)
{

	LOG_INF("Starting Exercise 1!");

	/* STEP 4 - Add some logic to the application */

	for (int i = 0; i < 10; i++) {
		test_var = test_var + 1;
		LOG_INF("test_var = %d", test_var);
	}

	return 0;
}
```
