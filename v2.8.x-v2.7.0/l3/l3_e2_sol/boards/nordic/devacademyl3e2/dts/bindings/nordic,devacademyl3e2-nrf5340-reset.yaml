## v2.8.x-v2.7.0/l3/l3_e2_sol/boards/nordic/devacademyl3e2/dts/bindings/nordic,devacademyl3e2-nrf5340-reset.yaml
```yaml
# Copyright (c) 2023 Nordic Semiconductor ASA
# SPDX-License-Identifier: Apache-2.0

description: GPIO used to reset nRF5340 on DevAcademyL3E2

compatible: "nordic,devacademyl3e2-nrf5340-reset"

include: base.yaml

properties:
  status:
    required: true

  gpios:
    type: phandle-array
    required: true
    description: |
      GPIO to use as nRF5340 reset line: output in nRF9151, input in nRF5340.
```

## v2.8.x-v2.7.0/l8/l8_e2_sol/sample.yaml
```yaml
sample:
  description: nRF Connect SDK Intermediate Course by Nordic Developer Academy (https://academy.nordicsemi.com/)
  name: nRF Connect SDK Intermediate Course (Lesson 8 - Exercise 2 Solution)

common:
  sysbuild: true

tests:
  sample.sysbuild.hello_world.nrf54l15dk_nrf54l15_cpuflpr:
    platform_allow:
      - nrf54l15dk/nrf54l15/cpuapp
    integration_platforms:
      - nrf54l15dk/nrf54l15/cpuapp
    extra_args:
      hello_world_SNIPPET=nordic-flpr
```

## v2.8.x-v2.7.0/lesson5/inter_less5_exer1_solution/sample.yaml
```yaml
sample:
  description: nRF Connect SDK Intermediate Course by Nordic Developer Academy (https://academy.nordicsemi.com/)
  name: nRF Connect SDK Intermediate Course (Lesson 5 - Exercise 1 Solution)
```

## v2.9.0-v2.7.0/l3/l3_e1_sol/boards/nordic/devacademyl3e1/Kconfig.defconfig
```kconfig
if BOARD_DEVACADEMYL3E1

config BT_CTLR
	default BT

endif # BOARD_DEVACADEMYL3E1
```

## v2.9.0-v2.7.0/l3/l3_e2_sol/boards/nordic/devacademyl3e2/board.yml
```yaml
board:
  name: devacademyl3e2
  vendor: nordic
  socs:
  - name: nrf9151
    variants:
    - name: 'ns'
```

## v2.9.0-v2.7.0/l7/l7_e1_sol/custom_driver_module/drivers/sensor/custom_bme280/Kconfig
```kconfig
config CUSTOM_BME280
	bool "Custom BME280 sensor"
	default n
	depends on DT_HAS_ZEPHYR_CUSTOM_BME280_ENABLED
	select SPI
	help
	  Enable custom BME280 driver
```

## v2.9.0-v2.7.0/l7/l7_e1_sol/custom_driver_module/dts/bindings/sensor/zephyr,custom-bme280.yaml
```yaml
# STEP 1: Create a binding file for the custom driver
description: BME280 integrated environmental sensor

compatible: "zephyr,custom-bme280"

include: [sensor-device.yaml, spi-device.yaml]
```

## v2.9.0-v2.7.0/l7/l7_e2_sol/custom_driver_module/dts/bindings/sensor/zephyr,custom-bme280.yaml
```yaml
description: BME280 integrated environmental sensor

compatible: "zephyr,custom-bme280"

include: [sensor-device.yaml, spi-device.yaml]
```

## v2.9.0-v2.7.0/l7/l7_e3/custom_driver_module/drivers/blink/Kconfig
```kconfig
# Copyright (c) 2024 Nordic Semiconductor ASA
# SPDX-License-Identifier: Apache-2.0

menuconfig BLINK
	bool "Blink device drivers"
	help
	  This option enables the blink custom driver class.

if BLINK

# STEP 4.4 - Define driver`s init priority 

module = BLINK
module-str = blink
source "subsys/logging/Kconfig.template.log_config"

config BLINK_GPIO_LED
	bool "GPIO-controlled LED blink driver"
	default y
	depends on DT_HAS_BLINK_GPIO_LED_ENABLED
	select GPIO
	help
	  Enable this option to use the GPIO-controlled LED blink driver. This
	  demonstrates how to implement a driver for a custom driver class.

endif # BLINK
```

## v2.9.0-v2.7.0/l7/l7_e3/custom_driver_module/dts/bindings/blink-gpio-leds.yaml
```yaml
# Copyright (c) 2024 Nordic Semiconductor ASA
# SPDX-License-Identifier: Apache-2.0

description: |
  A generic binding for a GPIO-controlled blinking LED. Note that this binding
  has no vendor prefix, as it does not target a specific device or vendor.

  Example definition in devicetree:

    blink-gpio-led {
        compatible = "blink-gpio-led";
        led-gpios = <&gpio0 0 GPIO_ACTIVE_HIGH>;
        blink-period-ms = <1000>;
    };

#STEP 1.1

#STEP 1.2

#STEP 1.3
```

## v2.9.0-v2.7.0/l7/l7_e3_sol/custom_driver_module/dts/bindings/blink-gpio-leds.yaml
```yaml
# Copyright (c) 2024 Nordic Semiconductor ASA
# SPDX-License-Identifier: Apache-2.0

description: |
  A generic binding for a GPIO-controlled blinking LED. Note that this binding
  has no vendor prefix, as it does not target a specific device or vendor.

  Example definition in devicetree:

    blink-gpio-led {
        compatible = "blink-gpio-led";
        led-gpios = <&gpio0 0 GPIO_ACTIVE_HIGH>;
        blink-period-ms = <1000>;
    };

#STEP 1.1
compatible: "blink-gpio-led"

include: base.yaml

#STEP 1.2
properties:
  led-gpios:
    type: phandle-array
    required: true
    description: GPIO-controlled LED.

#STEP 1.3
  blink-period-ms:
    type: int
    description: Initial blinking period in milliseconds.
```

## v2.9.0-v2.7.0/l8/l8_e2/sample.yaml
```yaml
sample:
  description: nRF Connect SDK Intermediate Course by Nordic Developer Academy (https://academy.nordicsemi.com/)
  name: nRF Connect SDK Intermediate Course (Lesson 8 - Exercise 2)

common: 
    sysbuild: true
    build_only: true
    skip: true
    integration_platforms: 
      - nrf5340dk/nrf5340/cpuapp
      - nrf5340dk/nrf5340/cpuapp/ns
      - nrf54l15dk/nrf54l15/cpuapp
      - nrf54l15dk/nrf54l15/cpuapp/ns
      - nrf7002dk/nrf5340/cpuapp
      - nrf7002dk/nrf5340/cpuapp/ns
    platform_exclude:
      - native_sim
    
tests:
  l8.e2: {}
```

## v2.9.0-v2.7.0/l8/l8_e2_sol/boards/nrf5340dk_nrf5340_cpuapp.conf
```kconfig
# Step 3.1 - Enable Network Core on application core startup
CONFIG_SOC_NRF53_CPUNET_ENABLE=y
```

## v2.9.0-v2.7.0/l9/l9_e6_sol/sample.yaml
```yaml
sample:
  description: nRF Connect SDK Intermediate Course by Nordic Developer Academy (https://academy.nordicsemi.com/)
  name: nRF Connect SDK Intermediate Course (Lesson 8 - Exercise 4 Solution)
```
