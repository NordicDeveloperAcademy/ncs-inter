## CMakeLists.txt
```
cmake_minimum_required(VERSION 3.20.0)
find_package(Zephyr REQUIRED HINTS $ENV{ZEPHYR_BASE})
project(nrf_connect_sdk_intermediate)

target_sources(app PRIVATE src/main.c)
```

## prj.conf
```kconfig
# Logging
CONFIG_LOG=y
CONFIG_LOG_PRINTK=y
CONFIG_LOG_MODE_IMMEDIATE=y
CONFIG_STDOUT_CONSOLE=y
CONFIG_PRINTK=y

# STEP 1.1 - Enable PWM
CONFIG_PWM=y
CONFIG_PWM_LOG_LEVEL_DBG=y

# STEP 1.2 - Enable LED and LED PWM
CONFIG_LED=y
CONFIG_LED_PWM=y
```

## src/main.c
```c
#include <zephyr/kernel.h>
#include <zephyr/logging/log.h>

/* STEP 1.3 - Include the relevant headers for pwm*/
#include <zephyr/device.h>
#include <zephyr/drivers/pwm.h>

LOG_MODULE_REGISTER(Lesson6_Exercise1, LOG_LEVEL_INF);

/* STEP 2 - Define the desired PWM period and pulse */
 #define PWM_PERIOD_NS 20000000
 #define PWM_DUTY_CYCLE 1400000

/* STEP 3.1 - Get the node identifier for [] through its alias */
#define PWM_LED0    DT_ALIAS(pwm_led0)

/* STEP 3.2 - Initialize and populate struct pwm_dt_spec */
static const struct pwm_dt_spec pwm_led0 = PWM_DT_SPEC_GET(PWM_LED0);

int main(void)
{

    /* STEP 3.3 - Check if the device is ready */
    if (!device_is_ready(pwm_led0.dev)) {
        LOG_ERR("PWM device %s is not ready", pwm_led0.dev->name);
        return 0;
	}
    
    /* STEP 4 - Control the LED with the control signal generated from the PWM */
    int err = pwm_set_dt(&pwm_led0, PWM_PERIOD_NS, PWM_DUTY_CYCLE);
    if (err) {
        LOG_ERR("Error in pwm_set_dt(), err: %d", err);
    }
    
    return 0;
}
```
