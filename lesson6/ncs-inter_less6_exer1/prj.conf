## prj.conf
```kconfig
# Logging
CONFIG_LOG=y
CONFIG_LOG_PRINTK=y
CONFIG_LOG_MODE_IMMEDIATE=y
CONFIG_STDOUT_CONSOLE=y
CONFIG_PRINTK=y

# STEP 1.1 - Enable PWM


# STEP 1.2 - Enable LED and LED PWM
```

## src/main.c
```c
#include <zephyr/kernel.h>
#include <zephyr/logging/log.h>

/* STEP 1.3 - Include the relevant headers for pwm*/


LOG_MODULE_REGISTER(Lesson6_Exercise1, LOG_LEVEL_INF);

/* STEP 2 - Define the desired PWM period and pulse */


/* STEP 3.1 - Get the node identifier for [] through its alias */


/* STEP 3.2 - Initialize and populate struct pwm_dt_spec */

void main(void)
{

    /* STEP 3.3 - Check if the device is ready */

    
    /* STEP 4 - Control the LED with the control signal generated from the PWM */
 
}
```
