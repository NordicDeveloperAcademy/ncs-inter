## CMakeLists.txt
```
#
# Copyright (c) 2016 Intel Corporation
# Copyright (c) 2020 Nordic Semiconductor ASA
#
# SPDX-License-Identifier: Apache-2.0
#

cmake_minimum_required(VERSION 3.20.0)
find_package(Zephyr REQUIRED HINTS $ENV{ZEPHYR_BASE})
project(nrf_connect_sdk_intermediate)

target_sources(app PRIVATE src/main.c)
```

## sample.yaml
```
sample:
  description: nRF Connect SDK Intermediate Course by Nordic Developer Academy (https://academy.nordicsemi.com/)
  name: nRF Connect SDK Intermediate Course (Lesson 4 - Exercise 1)
```

## prj.conf
```kconfig
#
# Copyright (c) 2016 Intel Corporation
# Copyright (c) 2020 Nordic Semiconductor ASA
#
# SPDX-License-Identifier: Apache-2.0
#

# Logging
CONFIG_LOG=y

# STEP 1.1 - Enable PWM


# STEP 1.2 - Enable LED and LED PWM
```

## boards/CHANGE_TO_YOUR_BUILD_TARGET_NAME.overlay
```dts
/* STEP 2.1 - Add the SPI peripheral to spi1 */

/* STEP 2.2 - Change the pin configuration */
```

## src/main.c
```c
/*
 * Copyright (c) 2016 Intel Corporation
 * Copyright (c) 2020 Nordic Semiconductor ASA
 *
 * SPDX-License-Identifier: Apache-2.0
 */

#include <zephyr/kernel.h>
#include <zephyr/logging/log.h>

/* STEP 1.3 - Include the relevant headers for pwm*/


LOG_MODULE_REGISTER(Lesson4_Exercise1, LOG_LEVEL_INF);

/* STEP 2 - Define the desired PWM period and pulse */



/* STEP 3.1 - Get the node identifier for [] through its alias */


/* STEP 3.2 - Initialize and populate struct pwm_dt_spec */


int main(void)
{
    int err;

    /* STEP 3.3 - Check if the device is ready */

    
    /* STEP 4 - Control the LED with the control signal generated from the PWM */


    return 0;
}
```
