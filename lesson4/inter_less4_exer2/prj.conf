## sample.yaml
```
sample:
  description: nRF Connect SDK Intermediate Course by Nordic Developer Academy (https://academy.nordicsemi.com/)
  name: nRF Connect SDK Intermediate Course (Lesson 4 - Exercise 2)
```

## prj.conf
```kconfig
#Logging configurations
CONFIG_LOG=y
CONFIG_PWM_LOG_LEVEL_DBG=y
CONFIG_LOG_PRINTK=y
CONFIG_LOG_MODE_IMMEDIATE=y
CONFIG_STDOUT_CONSOLE=y
CONFIG_PRINTK=y

# PWM and LED configurations
CONFIG_PWM=y
CONFIG_LED=y
CONFIG_LED_PWM=y

# DK library configurations 
CONFIG_DK_LIBRARY=y
```

## boards/CHANGE_TO_YOUR_BUILD_TARGET_NAME.overlay
```dts
/* STEP 1.4 - Configure which pins your custom pwm0 instance should use */


/* STEP 1.3 - Add your own custom pwm0 instance */


/* STEP 1.2 -  Add a pwm_led instance and change the polarity */



/* STEP 4.1 - Configure pwm0 to drive the GPIO pin for LED 1 */


/* STEP 5.2 - Add the servo device */


/* STEP 5.3 - Configure which pins pwm1 should use */
```

## src/main.c
```c
/*
 * Copyright (c) 2024 Nordic Semiconductor ASA
 *
 * SPDX-License-Identifier: LicenseRef-Nordic-5-Clause
 */
 
#include <zephyr/kernel.h>
#include <zephyr/logging/log.h>
#include <zephyr/device.h>
#include <zephyr/drivers/pwm.h>
#include <dk_buttons_and_leds.h>

LOG_MODULE_REGISTER(Lesson4_Exercise2, LOG_LEVEL_INF);

#define PWM_LED0        DT_ALIAS(pwm_led0)

/* STEP 5.7 - Define the servo motor through its nodelabel */
   

static const struct pwm_dt_spec pwm_led0 = PWM_DT_SPEC_GET(PWM_LED0);

/* STEP 5.4 - Retrieve the device structure for the servo motor */



/* STEP 5.5 - Use DT_PROP() to obtain the minimum and maximum duty cycle */


#define PWM_PERIOD   PWM_MSEC(20)

/* STEP  2.2 - Define minimum and maximum duty cycle */
/* STEP 4.2 - Change the duty cycles for the LED */


/* STEP 2.1 - Create a function to set the angle of the motor */


/* STEP 4.3 - Create a function to set the duty cycle of a PWM LED */

void button_handler(uint32_t button_state, uint32_t has_changed)
{
    int err = 0;
	if (has_changed & button_state)
	{
		switch (has_changed)
		{
            /* STEP 2.4 - Change motor angle when a button is pressed */
            /* STEP 5.6 - Update the button handler with the new duty cycle */

            /* STEP 4.4 - Change LED when a button is pressed */

		}
        if (err) {
            LOG_ERR("Error: couldn't set duty cycle, err %d", err);
        }
	}
}

int main(void)
{

    int err = 0;
        
    if (dk_buttons_init(button_handler)) {
        LOG_ERR("Failed to initialize the buttons library");
    }

    /* STEP 2.3 - Check if the device is ready and set its initial value */


    /* STEP 5.7 - Check if the motor device is ready and set its initial value */


    return 0;
}
```

## src/ili_screen_controller.c
```c
/*
 * Copyright (c) 2024 Nordic Semiconductor ASA
 *
 * SPDX-License-Identifier: Apache-2.0
 */

#include <zephyr/kernel.h>
#include <zephyr/logging/log.h>

/* STEP 3.1 - Include the header files for SPI, GPIO and devicetree */
#include <zephyr/device.h>
#include <zephyr/devicetree.h>
#include <zephyr/drivers/gpio.h>
#include <zephyr/drivers/spi.h>

/* STEP 3.2 - Include display driver and custom header files */


LOG_MODULE_DECLARE(Lesson4_Exercise2, LOG_LEVEL_INF);

/* Structure for ILI9340 controller configuration*/
enum madctl_cmd_set {CMD_SET_1,	CMD_SET_2,};
struct ili9xxx_quirks {enum madctl_cmd_set cmd_set;};
struct ili_ctrl_config {
	const struct ili9xxx_quirks *quirks;
	struct spi_dt_spec spi;
	struct gpio_dt_spec cmd_data;
	struct gpio_dt_spec reset;
	uint8_t pixel_format;
	uint16_t rotation;
	uint16_t x_resolution;
	uint16_t y_resolution;
	bool inversion;
	const void *regs;
	int (*regs_init_fn)(const struct device *dev);
};

/* Structure for ILI9340 controller data*/
struct ili_ctrl_data {
	uint8_t bytes_per_pixel;
	enum display_pixel_format pixel_format;
	enum display_orientation orientation;
};

/* Function to fill buffer with RBG color */
void fill_buf_24bit(uint32_t color, uint8_t *buf, size_t buf_size)
{
	for (size_t idx = 0; idx < buf_size; idx += 3) {
		*(buf + idx + 0) = color >> 16;
		*(buf + idx + 1) = color >> 8;
		*(buf + idx + 2) = color >> 0;
	}
}

/* Function for Screen SPI Controller to transmit the command and data
 * It takes device pointer, 1-byte command, data pointer and length
 * The function calls underlying GPIO and SPI functions to transfer */
int spi_ctrl_transmit(const struct device *dev, uint8_t cmd, const void *tx_data, size_t tx_len)
{
	int err;
	const struct ili_ctrl_config *config = dev->config;
	
	/* STEP 4.1 - Declare and configure the transmit buffers with command parameters */
	

	/* STEP 4.2 - Set GPIO pin for Command and write using spi_write_dt() */
	

	/* STEP 4.3 - Transmit the data that follows the command, if any. */
	

	return 0;
}

/* Function to set ili controller memory area
 * It takes device pointer, (x,y) coordinates, and (w,h) area parameters
 * w=width h=height x_start=x, x_end=x+w-1, y_end=y+h-1
 * The function calls spi_ctrl_transmit() to transmit command & data */
int ili_ctrl_setmem(const struct device *dev, const uint16_t x, const uint16_t y, \
						   const uint16_t w, const uint16_t h)
{
	int err;
	uint16_t spi_xdata[2];
	uint16_t spi_ydata[2];

	/* Set and transmit column and row starting and ending address */
	spi_xdata[0] = sys_cpu_to_be16(x);
	spi_xdata[1] = sys_cpu_to_be16(x + w - 1U);
	spi_ydata[0] = sys_cpu_to_be16(y);
	spi_ydata[1] = sys_cpu_to_be16(y + h - 1U);

	/* STEP 5 - Call spi_ctrl_transmit() to transmit CASET and PASET commands */
	

	return 0;
}

/* Function to write to the screen
 * It takes device pointer, (x,y) starting coordinates, descriptor and buffer
 * It calls ili_ctrl_setmem() to set the active area
 * And then writes buffer into active area memory using spi_ctrl_transmit() */
int screen_write(const struct device *dev, const uint16_t x, const uint16_t y, \
			 const struct display_buffer_descriptor *desc, const void *buf)
{
	int err;
	const uint8_t *data_start_addr = (const uint8_t *)buf;

	const struct ili_ctrl_config *config = dev->config;
	struct ili_ctrl_data *data = dev->data;

	struct spi_buf tx_buf;
	struct spi_buf_set tx_bufs;

	uint16_t write_cnt;
	uint16_t nbr_of_writes;
	uint16_t write_h;

	err = ili_ctrl_setmem(dev, x, y, desc->width, desc->height);
	if (err < 0) {
		return err;
	}

	if (desc->pitch > desc->width) {write_h = 1U; nbr_of_writes = desc->height;}
	else {write_h = desc->height; nbr_of_writes = 1U;}

	/* STEP 6 - Call spi_ctrl_transmit() to send the RAMWR command */
	

	tx_bufs.buffers = &tx_buf;
	tx_bufs.count = 1;

	data_start_addr += desc->pitch * data->bytes_per_pixel;
	for (write_cnt = 1U; write_cnt < nbr_of_writes; ++write_cnt) {
		tx_buf.buf = (void *)data_start_addr;
		tx_buf.len = desc->width * data->bytes_per_pixel * write_h;

		err = spi_write_dt(&config->spi, &tx_bufs);
		if (err < 0) {
			return err;
		}

		data_start_addr += desc->pitch * data->bytes_per_pixel;
	}

	return 0;
}
```

## src/ili_screen_controller.h
```c
/*
 * Copyright (c) 2017 Jan Van Winkel <jan.van_winkel@dxplore.eu>
 * Copyright (c) 2023 Nordic Semiconductor ASA
 * Copyright (c) 2020 Teslabs Engineering S.L.
 * Copyright (c) 2021 Krivorot Oleg <krivorot.oleg@gmail.com>
 *
 * SPDX-License-Identifier: Apache-2.0
 */
#ifndef ILI_SCREEN_CONTROLLER_H_
#define ILI_SCREEN_CONTROLLER_H_

/* Commands/registers. */
#define ILI9XXX_SWRESET 0x01
#define ILI9XXX_SLPOUT 0x11
#define ILI9XXX_DINVON 0x21
#define ILI9XXX_GAMSET 0x26
#define ILI9XXX_DISPOFF 0x28
#define ILI9XXX_DISPON 0x29
#define ILI9XXX_CASET 0x2a
#define ILI9XXX_PASET 0x2b
#define ILI9XXX_RAMWR 0x2c
#define ILI9XXX_MADCTL 0x36
#define ILI9XXX_PIXSET 0x3A

/* MADCTL register fields. */
#define ILI9XXX_MADCTL_MY BIT(7U)
#define ILI9XXX_MADCTL_MX BIT(6U)
#define ILI9XXX_MADCTL_MV BIT(5U)
#define ILI9XXX_MADCTL_ML BIT(4U)
#define ILI9XXX_MADCTL_BGR BIT(3U)
#define ILI9XXX_MADCTL_MH BIT(2U)

/* PIXSET register fields. */
#define ILI9XXX_PIXSET_RGB_18_BIT 0x60
#define ILI9XXX_PIXSET_RGB_16_BIT 0x50
#define ILI9XXX_PIXSET_MCU_18_BIT 0x06
#define ILI9XXX_PIXSET_MCU_16_BIT 0x05

/** Command/data GPIO level for Data/Command. */
#define ILI9XXX_DATA 0U
#define ILI9XXX_CMD 1U

/** Sleep out time (ms), ref. 8.2.12 of ILI9XXX manual. */
#define ILI9XXX_SLEEP_OUT_TIME 120

/** Reset pulse time (ms), ref 15.4 of ILI9XXX manual. */
#define ILI9XXX_RESET_PULSE_TIME 1

/** Reset wait time (ms), ref 15.4 of ILI9XXX manual. */
#define ILI9XXX_RESET_WAIT_TIME 5

void fill_buf_24bit(uint32_t color, uint8_t *buf, size_t buf_size);

int spi_ctrl_transmit(const struct device *dev, uint8_t cmd, const void *tx_data, size_t tx_len);

int ili_ctrl_setmem(const struct device *dev, const uint16_t x, const uint16_t y, \
						   const uint16_t w, const uint16_t h);

int screen_write(const struct device *dev, const uint16_t x, const uint16_t y, \
			 const struct display_buffer_descriptor *desc, const void *buf);

#endif /* ILI_SCREEN_CONTROLLER_H_ */
```
