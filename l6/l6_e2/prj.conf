## sample.yaml
```
sample:
  description: nRF Connect SDK Intermediate Course by Nordic Developer Academy (https://academy.nordicsemi.com/)
  name: nRF Connect SDK Intermediate Course - Lesson 6 Exercise 2
  
common: 
    sysbuild: true
    build_only: true
    skip: true
    integration_platforms: 
      - nrf52dk/nrf52832
      - nrf52833dk/nrf52833
      - nrf52840dk/nrf52840
      - nrf9160dk/nrf9160
      - nrf9161dk/nrf9161
      - nrf9151dk/nrf9151
      - nrf5340dk/nrf5340/cpuapp
      - nrf54l15dk/nrf54l15/cpuapp
      - nrf54lc10dk/nrf54lc10a/cpuapp
      - nrf54l15dk/nrf54l15/cpuapp/ns
      - nrf54ls05dk/nrf54ls05b/cpuapp
      - nrf54lm20dk/nrf54lm20a/cpuapp
      - nrf7002dk/nrf5340/cpuapp
    platform_allow:
      - nrf52dk/nrf52832
      - nrf52833dk/nrf52833
      - nrf52840dk/nrf52840
      - nrf9160dk/nrf9160
      - nrf9161dk/nrf9161
      - nrf9151dk/nrf9151
      - nrf5340dk/nrf5340/cpuapp
      - nrf54l15dk/nrf54l15/cpuapp
      - nrf54lc10dk/nrf54lc10a/cpuapp
      - nrf54l15dk/nrf54l15/cpuapp/ns
      - nrf54ls05dk/nrf54ls05b/cpuapp
      - nrf54lm20dk/nrf54lm20a/cpuapp
      - nrf7002dk/nrf5340/cpuapp
    
tests:
  ncs_inter.l6.e2: {}
```

## prj.conf
```kconfig
#
# Copyright (c) 2024 Nordic Semiconductor
#
# SPDX-License-Identifier: LicenseRef-Nordic-5-Clause
#

# STEP 1 - Enable nrfx SAADC driver #
```

## src/main.c
```c
/*
 * Copyright (c) 2024 Nordic Semiconductor ASA
 *
 * SPDX-License-Identifier: LicenseRef-Nordic-5-Clause
 */

#include <zephyr/kernel.h>
#include <zephyr/sys/printk.h>

/* STEP 2 - Include header for nrfx SAADC driver */


/* STEP 3.1 - Declare the struct to hold the configuration for the SAADC channel used to sample the battery voltage */


/* STEP 3.2 - Declare the buffer to hold the SAAD sample value */


/* STEP 4.1 - Define the battery sample interval */


/* STEP 4.3 - Add forward declaration of timer callback handler */


/* STEP 4.2 - Define the battery sample timer instance */


/* STEP 7.1 - Implement timer callback handler function */


static void configure_saadc(void)
{
        /* STEP 5.1 - Connect ADC interrupt to nrfx interrupt handler */

        
        /* STEP 5.2 - Initialize the nrfx_SAADC driver */


        /* STEP 5.3 - Configure the SAADC channel */


        /* STEP 5.4 - Configure nrfx_SAADC driver in simple and blocking mode */


        /* STEP 5.5 - Set buffer where sample will be stored */


        /* STEP 6 - Start periodic timer for battery sampling */


}

int main(void)
{
        configure_saadc();

        k_sleep(K_FOREVER);
        return 0;
}
```
