## sample.yaml
```
sample:
  description: nRF Connect SDK Intermediate Course by Nordic Developer Academy (https://academy.nordicsemi.com/)
  name: nRF Connect SDK Intermediate Course - Lesson 6 Exercise 3
  
common: 
    sysbuild: true
    build_only: true
    skip: true
    integration_platforms: 
      - nrf52dk/nrf52832
      - nrf52833dk/nrf52833
      - nrf52840dk/nrf52840
      - nrf9160dk/nrf9160
      - nrf9161dk/nrf9161
      - nrf9151dk/nrf9151
      - nrf5340dk/nrf5340/cpuapp
      - nrf54l15dk/nrf54l15/cpuapp
      - nrf54lc10dk/nrf54lc10a/cpuapp
      - nrf54l15dk/nrf54l15/cpuapp/ns
      - nrf54ls05dk/nrf54ls05b/cpuapp
      - nrf54lm20dk/nrf54lm20a/cpuapp
      - nrf7002dk/nrf5340/cpuapp
    platform_allow:
      - nrf52dk/nrf52832
      - nrf52833dk/nrf52833
      - nrf52840dk/nrf52840
      - nrf9160dk/nrf9160
      - nrf9161dk/nrf9161
      - nrf9151dk/nrf9151
      - nrf5340dk/nrf5340/cpuapp
      - nrf54l15dk/nrf54l15/cpuapp
      - nrf54lc10dk/nrf54lc10a/cpuapp
      - nrf54l15dk/nrf54l15/cpuapp/ns
      - nrf54ls05dk/nrf54ls05b/cpuapp
      - nrf54lm20dk/nrf54lm20a/cpuapp
      - nrf7002dk/nrf5340/cpuapp
    
tests:
  ncs_inter.l6.e3: {}
```

## prj.conf
```kconfig
#
# Copyright (c) 2024 Nordic Semiconductor
#
# SPDX-License-Identifier: LicenseRef-Nordic-5-Clause
#

CONFIG_LOG=y

# STEP 1 - Enable nrfx drivers #
```

## src/main.c
```c
/*
 * Copyright (c) 2023 Nordic Semiconductor ASA
 *
 * SPDX-License-Identifier: LicenseRef-Nordic-5-Clause
 */

#include <zephyr/kernel.h>
#include <zephyr/logging/log.h>

LOG_MODULE_REGISTER(Lesson6_Exercise3, LOG_LEVEL_DBG);

/* STEP 2 - Include header for nrfx drivers */


/* STEP 3.1 - Define the SAADC sample interval in microseconds */


/* STEP 4.1 - Define the buffer size for the SAADC */


/* STEP 4.6 - Declare the struct to hold the configuration for the SAADC channel used to sample the battery voltage */


/* STEP 3.2 - Declaring an instance of nrfx_timer for TIMER2. */


/* STEP 4.2 - Declare the buffers for the SAADC */


/* STEP 4.3 - Declare variable used to keep track of which buffer was last assigned to the SAADC driver */


static void configure_timer(void)
{
    int err;

    /* STEP 3.3 - Declaring timer config and intialize nrfx_timer instance. */


    /* STEP 3.4 - Set compare channel 0 to generate event every SAADC_SAMPLE_INTERVAL_US. */


}

static void saadc_event_handler(nrfx_saadc_evt_t const * p_event)
{
    int err;
    switch (p_event->type)
    {
        case NRFX_SAADC_EVT_READY:
        
           /* STEP 5.1 - Buffer is ready, timer (and sampling) can be started. */


            break;                        
            
        case NRFX_SAADC_EVT_BUF_REQ:
        
            /* STEP 5.2 - Set up the next available buffer. Alternate between buffer 0 and 1 */


            break;

        case NRFX_SAADC_EVT_DONE:

            /* STEP 5.3 - Buffer has been filled. Do something with the data and proceed */


            break;

        default:
            LOG_INF("Unhandled SAADC evt %d", p_event->type);
            break;
    }
}

static void configure_saadc(void)
{
    int err;

    /* STEP 4.4 - Connect ADC interrupt to nrfx interrupt handler */


    /* STEP 4.5 - Initialize the nrfx_SAADC driver */


    /* STEP 4.7 - Change gain config in default config and apply channel configuration */


    /* STEP 4.8 - Configure channel 0 in advanced mode with event handler (non-blocking mode) */


    /* STEP 4.9 - Configure two buffers to make use of double-buffering feature of SAADC */


    /* STEP 4.10 - Trigger the SAADC. This will not start sampling, but will prepare buffer for sampling triggered through PPI */


}

static void configure_ppi(void)
{
    int err;
    /* STEP 6.1 - Declare variables used to hold the (D)PPI channel number */


    /* STEP 6.2 - Trigger task sample from timer */

    /* STEP 6.3 - Trigger task start from end event */

    /* STEP 6.4 - Enable both (D)PPI channels */ 

}


int main(void)
{
    configure_timer();
    configure_saadc();  
    configure_ppi();
    k_sleep(K_FOREVER);
}
```
