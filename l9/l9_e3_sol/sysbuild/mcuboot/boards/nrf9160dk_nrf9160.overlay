/* STEP 2.2 - Include overlay file from the application  */
#include "../../../boards/nrf9160dk_nrf9160.overlay"

/* STEP 2.3 - Configure bootloader to start from boot_partition  */
/ {
    chosen {
        zephyr,code-partition = &boot_partition;
    };
};
