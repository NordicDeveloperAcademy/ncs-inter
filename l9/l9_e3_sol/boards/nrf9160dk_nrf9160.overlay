/delete-node/ &slot1_partition;

&mx25r64 {
    status = "okay";

    partitions {
        compatible = "fixed-partitions";
        #address-cells = <1>;
        #size-cells = <1>;

        slot1_partition: partition@0 {
            label = "image-1";
            reg = <0x00000 0xe0000>;
        };
    };
};

&slot0_partition {
    reg = <0x00010000 0xe0000>;
    ranges = <0x0 0x10000 0xe0000>;
};

