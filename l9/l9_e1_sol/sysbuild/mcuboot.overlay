
/* STEP 3.4 - Configure button and LED for Serial Recovery */
/ {
  aliases {
		mcuboot-button0 = &button1;
		mcuboot-led0 = &led1;
  };
};


/* STEP 2.5 - Configure mcuboot start partition */
/ {
	chosen {
		zephyr,code-partition = &boot_partition;
	};
};
