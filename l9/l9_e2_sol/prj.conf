## sample.yaml
```
sample:
  description: nRF Connect SDK Intermediate Course by Nordic Developer Academy (https://academy.nordicsemi.com/)
  name: nRF Connect SDK Intermediate Course - Lesson 9 Exercise 2 Solution
  
common: 
    sysbuild: true
    build_only: true

    
tests:
  ncs_inter.l9.e2_sol.ed25519_invalid:
    integration_platforms: 
      - nrf54l15dk/nrf54l15/cpuapp
      - nrf54lc10dk/nrf54lc10a/cpuapp
      - nrf54ls05dk/nrf54ls05b/cpuapp
      - nrf54lm20dk/nrf54lm20a/cpuapp
    platform_allow: 
      - nrf54l15dk/nrf54l15/cpuapp
      - nrf54lc10dk/nrf54lc10a/cpuapp
      - nrf54ls05dk/nrf54ls05b/cpuapp
      - nrf54lm20dk/nrf54lm20a/cpuapp
    extra_args:
      - SB_CONFIG_BOOT_SIGNATURE_TYPE_ED25519=y
      - SB_CONFIG_BOOT_SIGNATURE_TYPE_ECDSA_P256=n
      - SB_CONFIG_BOOT_SIGNATURE_KEY_FILE="\${APP_DIR}/ed_ci_key_invalid.pem"
      - SB_CONFIG_MCUBOOT_GENERATE_DEFAULT_KEY_FILE=y


  ncs_inter.l9.e2_sol.ecdsa_invalid:
    integration_platforms: 
      - nrf52dk/nrf52832
      - nrf52833dk/nrf52833
      - nrf52840dk/nrf52840
      - nrf9160dk/nrf9160
      - nrf9161dk/nrf9161
      - nrf9151dk/nrf9151
      - nrf5340dk/nrf5340/cpuapp
      - nrf7002dk/nrf5340/cpuapp
    platform_allow: 
      - nrf52dk/nrf52832
      - nrf52833dk/nrf52833
      - nrf52840dk/nrf52840
      - nrf9160dk/nrf9160
      - nrf9161dk/nrf9161
      - nrf9151dk/nrf9151
      - nrf5340dk/nrf5340/cpuapp
      - nrf7002dk/nrf5340/cpuapp
    extra_args:
      - SB_CONFIG_BOOT_SIGNATURE_KEY_FILE="\${APP_DIR}/ecdsa_ci_key_invalid.pem"
      - SB_CONFIG_BOOT_SIGNATURE_TYPE_ED25519=n
      - SB_CONFIG_BOOT_SIGNATURE_TYPE_ECDSA_P256=y


  ncs_inter.l9.e2_sol.ed25519:
    integration_platforms: 
      - nrf54l15dk/nrf54l15/cpuapp
      - nrf54lc10dk/nrf54lc10a/cpuapp
      - nrf54ls05dk/nrf54ls05b/cpuapp
      - nrf54lm20dk/nrf54lm20a/cpuapp
    platform_allow: 
      - nrf54l15dk/nrf54l15/cpuapp
      - nrf54lc10dk/nrf54lc10a/cpuapp
      - nrf54ls05dk/nrf54ls05b/cpuapp
      - nrf54lm20dk/nrf54lm20a/cpuapp
    extra_args:
      - SB_CONFIG_BOOT_SIGNATURE_TYPE_ED25519=y
      - SB_CONFIG_BOOT_SIGNATURE_TYPE_ECDSA_P256=n
      - SB_CONFIG_MCUBOOT_GENERATE_DEFAULT_KEY_FILE=y
      - SB_CONFIG_BOOT_SIGNATURE_KEY_FILE="\${APP_DIR}/ed_ci_key.pem"

  ncs_inter.l9.e2_sol.ecdsa:
    integration_platforms: 
      - nrf52dk/nrf52832
      - nrf52833dk/nrf52833
      - nrf52840dk/nrf52840
      - nrf9160dk/nrf9160
      - nrf9161dk/nrf9161
      - nrf9151dk/nrf9151
      - nrf5340dk/nrf5340/cpuapp
      - nrf7002dk/nrf5340/cpuapp
    platform_allow: 
      - nrf52dk/nrf52832
      - nrf52833dk/nrf52833
      - nrf52840dk/nrf52840
      - nrf9160dk/nrf9160
      - nrf9161dk/nrf9161
      - nrf9151dk/nrf9151
      - nrf5340dk/nrf5340/cpuapp
      - nrf7002dk/nrf5340/cpuapp
    extra_args:
      - SB_CONFIG_BOOT_SIGNATURE_KEY_FILE="\${APP_DIR}/ecdsa_ci_key.pem"
      - SB_CONFIG_BOOT_SIGNATURE_TYPE_ED25519=n
      - SB_CONFIG_BOOT_SIGNATURE_TYPE_ECDSA_P256=y
```

## sysbuild.conf
```
# Add MCUboot
SB_CONFIG_BOOTLOADER_MCUBOOT=y

SB_CONFIG_PARTITION_MANAGER=n

# STEP 2.1 - Add private key for MCUboot
#SB_CONFIG_BOOT_SIGNATURE_KEY_FILE="\${APP_DIR}/do_not_use_this_key.pem"
SB_CONFIG_BOOT_SIGNATURE_KEY_FILE="\${APP_DIR}/ed_ci_key.pem"

# STEP 2.2. - Configure key type
SB_CONFIG_MCUBOOT_SIGNATURE_USING_KMU=y

#Use ED25519 for nRF54 Series or ECDSA for other boards
SB_CONFIG_BOOT_SIGNATURE_TYPE_ED25519=y
#SB_CONFIG_BOOT_SIGNATURE_TYPE_ECDSA_P256=y

# STEP 2.3 - Provision KMU automatically through the build system/nrfutil (nRF54L only)
SB_CONFIG_MCUBOOT_GENERATE_DEFAULT_KEY_FILE=y
```

## prj.conf
```kconfig
CONFIG_GPIO=y

# Enable MCUboot
CONFIG_BOOTLOADER_MCUBOOT=y

# Enable mcumgr DFU in application
CONFIG_MCUMGR=y

# Enable MCUMGR management for both OS and Images
CONFIG_MCUMGR_GRP_OS=y
CONFIG_MCUMGR_GRP_IMG=y

# Configure MCUMGR transport to UART
CONFIG_MCUMGR_TRANSPORT_UART=y

# Dependencies
# Configure dependencies for CONFIG_MCUMGR  
CONFIG_NET_BUF=y
CONFIG_ZCBOR=y
CONFIG_CRC=y

# Configure dependencies for CONFIG_MCUMGR_GRP_IMG  
CONFIG_FLASH=y
CONFIG_IMG_MANAGER=y

# Configure dependencies for CONFIG_IMG_MANAGER  
CONFIG_STREAM_FLASH=y
CONFIG_FLASH_MAP=y

# Configure dependencies for CONFIG_MCUMGR_TRANSPORT_UART 
CONFIG_BASE64=y
```

## src/main.c
```c
/*
 * Copyright (c) 2016 Intel Corporation
 *
 * SPDX-License-Identifier: Apache-2.0
 */

#include <zephyr/kernel.h>
#include <zephyr/drivers/gpio.h>
#include <zephyr/logging/log.h>

LOG_MODULE_REGISTER(Lesson9_Exercise2, LOG_LEVEL_INF);

/* 1000 msec = 1 sec */
#define SLEEP_TIME_MS   1000

/* The devicetree node identifier for the "led0" alias. */
#define LED0_NODE DT_ALIAS(led0)

/*
 * A build error on this line means your board is unsupported.
 * See the sample documentation for information on how to fix this.
 */
static const struct gpio_dt_spec led = GPIO_DT_SPEC_GET(LED0_NODE, gpios);

int main(void)
{
	int ret;

	if (!device_is_ready(led.port)) {
		return -1;
	}

	ret = gpio_pin_configure_dt(&led, GPIO_OUTPUT_ACTIVE);
	if (ret < 0) {
		return -1;
	}

	while (1) {
		ret = gpio_pin_toggle_dt(&led);
		if (ret < 0) {
			return -1;
		}
		k_msleep(SLEEP_TIME_MS);
	}
}
```
