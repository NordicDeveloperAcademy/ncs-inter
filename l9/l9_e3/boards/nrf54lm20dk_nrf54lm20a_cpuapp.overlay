/delete-node/ &boot_partition;
/delete-node/ &slot0_partition;
/delete-node/ &slot1_partition;


&cpuapp_rram {
    partitions {
        boot_partition: partition@0 {
            compatible = "zephyr,mapped-partition";
            label = "mcuboot";
            reg = <0x0 DT_SIZE_K(100)>;
        };

        slot0_partition: partition@19000 {
            compatible = "zephyr,mapped-partition";
            label = "image-0";
            reg = <0x19000 DT_SIZE_K(1536)>;
        };
    };
};

/* STEP 2.1 - Add external flash to board conf file */

