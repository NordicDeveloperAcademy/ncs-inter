/*
 * Copyright (c) 2023 Nordic Semiconductor ASA
 *
 * SPDX-License-Identifier: LicenseRef-Nordic-5-Clause
 */
#include "../boards/nrf7002dk_nrf5340_cpuapp_ns.overlay"

/ {
	chosen {
		zephyr,code-partition = &boot_partition;
	};
};

/* MCUboot uses slot0 as primary and slot1 (external flash) as secondary */